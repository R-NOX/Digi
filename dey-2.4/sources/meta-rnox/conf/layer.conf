## dey-2.4/sources/meta-rnox/conf/layer.conf
```bitbake
# We have a conf and classes directory, add to BBPATH
BBPATH .= ":${LAYERDIR}"

# We have recipes-* directories, add to BBFILES
BBFILES += "${LAYERDIR}/recipes-*/*/*.bb \
	${LAYERDIR}/recipes-*/*/*.bbappend"

BBFILE_COLLECTIONS += "rnox"
BBFILE_PATTERN_rnox = "^${LAYERDIR}/"
BBFILE_PRIORITY_rnox = "6"
```
